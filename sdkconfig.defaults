## sdkconfig.defaults
```kconfig
# Default sdkconfig for ESP32-S3 Modbus RTU project (ESP-IDF v5.4.x)
# Only valid Kconfig symbols in CONFIG_X=value form belong here.

# Run the CPU at 240 MHz
CONFIG_ESP_DEFAULT_CPU_FREQ_MHZ_240=y

# FreeRTOS tick rate 1000 Hz for finer vTaskDelay granularity
CONFIG_FREERTOS_HZ=1000
```
